## boards/shields/KobitoKey/Kconfig.defconfig
```kconfig
# 左手（Peripheral）側のデフォルト
if SHIELD_KOBITOKEY_LEFT
config ZMK_KEYBOARD_NAME
    default "KobitoKey"
endif

# 左右共通で有効化する機能群
if SHIELD_KOBITOKEY_LEFT || SHIELD_KOBITOKEY_RIGHT
# Split 構成を標準で有効化
config ZMK_SPLIT
    default y
# ポインティングデバイス（トラックボール）を有効化
config ZMK_POINTING
    default y
# BLE 接続を利用
config ZMK_BLE
    default y
# マウス HID 機能を有効化
config ZMK_MOUSE
    default y
# トラックボール通信用の SPI/I2C 入力を許可
config SPI
    default y
config INPUT
    default y
# PixArt PMW3610 ドライバ関連
config PMW3610
    default y
config PMW3610_SMART_ALGORITHM
    default y
config PMW3610_REPORT_INTERVAL_MIN
    default 12
# センサー回転補正を有効化
config SENSOR_ROTATION
    default y
# バッテリー情報を収集
config ZMK_BATTERY_REPORTING
    default y
# Split BLE 関連機能を共通で有効にする
config ZMK_SPLIT_BLE
    default y
endif
```

## config/west.yml
```yaml
manifest:
  remotes:
    - name: zmkfirmware
      url-base: https://github.com/zmkfirmware
    - name: badjeff
      url-base: https://github.com/badjeff
    - name: hsgw
      url-base: https://github.com/hsgw
    - name: caksoylar
      url-base: https://github.com/caksoylar

  projects:
    # ZMK 本体。公式 app/west.yml を取り込む
    - name: zmk
      remote: zmkfirmware
      revision: v0.3
      import: app/west.yml

    # PMW3610 ドライバ（保守が進んでいるフォークを利用）
    - name: zmk-pmw3610-driver
      remote: badjeff
      revision: main

    # センサー回転機能（ハンズオン中のモジュール）
    - name: zmk-feature-sensor_rotation
      remote: hsgw
      revision: main

    # RGB LED status widget
    - name: zmk-rgbled-widget
      remote: caksoylar
      revision: main

  self:
    path: config
```
